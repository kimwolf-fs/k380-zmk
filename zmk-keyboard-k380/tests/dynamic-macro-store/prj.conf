## CMakeLists.txt
```
cmake_minimum_required(VERSION 3.20.0)
find_package(Zephyr REQUIRED HINTS $ENV{ZEPHYR_BASE})
project(k380_dynamic_macro_store_tests)

target_sources(app PRIVATE
  ../../src/dynamic_macro_vm_validate.c
  ../../src/dynamic_macro_store.c
  src/fake_settings.c
  src/main.c
)
target_include_directories(app PRIVATE ../../include)
target_compile_definitions(app PRIVATE K380_DYNAMIC_MACRO_STORE_TEST_BACKEND)
```

## prj.conf
```kconfig
CONFIG_ZTEST=y
CONFIG_SETTINGS=y
```

## src/main.c
```c
#include <errno.h>
#include <string.h>

#include <zephyr/sys/byteorder.h>
#include <zephyr/ztest.h>

#include <zmk_keyboard_k380/dynamic_macro_record.h>
#include <zmk_keyboard_k380/dynamic_macro_store.h>

#include "fake_settings.h"

static const uint8_t canonical_package[] = {
    0x4b, 0x56, 0x4d, 0x31, 0x01, 0x00, 0x00, 0x00,
    0x0c, 0x00, 0x00, 0x00, 0x61, 0x55, 0x24, 0x9c,
    0x01, 0x04, 0x00, 0x10, 0xc0, 0x27, 0x09, 0x00,
    0x02, 0x04, 0x00, 0x00,
};

static void make_record(struct k380_dynamic_macro_record *record)
{
    memset(record, 0, sizeof(*record));
    record->record_version = K380_DYNAMIC_MACRO_RECORD_VERSION;
    record->trigger = K380_DYNAMIC_MACRO_TRIGGER_COUNT;
    record->name_len = 4U;
    memcpy(record->name, "test", 4U);
    record->repeat_count = 3U;
    record->package_len = sizeof(canonical_package);
    record->package_crc32 = 0x9c245561U;
    memcpy(record->package, canonical_package, sizeof(canonical_package));
}

static void make_legacy(struct k380_dynamic_macro *legacy)
{
    memset(legacy, 0, sizeof(*legacy));
    legacy->trigger = K380_DYNAMIC_MACRO_TRIGGER_ONCE;
    legacy->name[0] = 'v';
    legacy->name[1] = '1';
    legacy->count = 1U;
    legacy->step_count = 3U;
    legacy->steps[0].type = K380_DYNAMIC_MACRO_PRESS_KEY;
    legacy->steps[0].value.key_usage = 4U;
    legacy->steps[1].type = K380_DYNAMIC_MACRO_WAIT_MS;
    legacy->steps[1].value.wait_ms = 60000U;
    legacy->steps[2].type = K380_DYNAMIC_MACRO_RELEASE_KEY;
    legacy->steps[2].value.key_usage = 4U;
}

ZTEST(dynamic_macro_store, test_record_wire_encoding_is_explicit_and_exact)
{
    struct k380_dynamic_macro_record record;
    uint8_t wire[K380_DYNAMIC_MACRO_RECORD_MAX_BYTES];
    size_t wire_len = 0U;

    make_record(&record);
    zassert_ok(k380_dynamic_macro_record_encode(&record, wire, sizeof(wire),
                                                &wire_len));
    zassert_equal(48U + sizeof(canonical_package), wire_len);
    zassert_equal(2U, wire[0]);
    zassert_equal(K380_DYNAMIC_MACRO_TRIGGER_COUNT, wire[1]);
    zassert_equal(4U, wire[2]);
    zassert_equal(3U, sys_get_le32(&wire[4]));
    zassert_equal(sizeof(canonical_package), sys_get_le16(&wire[8]));
    zassert_equal(0x9c245561U, sys_get_le32(&wire[12]));
    zassert_mem_equal(&wire[16], "test", 4U);
    zassert_mem_equal(&wire[48], canonical_package, sizeof(canonical_package));
}

ZTEST(dynamic_macro_store, test_record_round_trip_and_crc_validation)
{
    struct k380_dynamic_macro_record source;
    struct k380_dynamic_macro_record decoded;
    uint8_t wire[K380_DYNAMIC_MACRO_RECORD_MAX_BYTES];
    size_t wire_len = 0U;

    make_record(&source);
    zassert_ok(k380_dynamic_macro_record_encode(&source, wire, sizeof(wire),
                                                &wire_len));
    zassert_ok(k380_dynamic_macro_record_decode(&decoded, wire, wire_len));
    zassert_mem_equal(&source, &decoded, sizeof(source));

    wire[48] ^= 0x80U;
    zassert_not_equal(0, k380_dynamic_macro_record_decode(&decoded, wire,
                                                          wire_len));
}

ZTEST(dynamic_macro_store, test_legacy_flat_macro_converts_to_vm)
{
    struct k380_dynamic_macro legacy;
    struct k380_dynamic_macro_record record;

    make_legacy(&legacy);

    zassert_ok(k380_dynamic_macro_record_from_legacy(&legacy, &record));
    zassert_equal(K380_DYNAMIC_MACRO_RECORD_VERSION, record.record_version);
    zassert_equal(K380_DYNAMIC_MACRO_TRIGGER_ONCE, record.trigger);
    zassert_true(record.package_len > 0U);
    zassert_ok(k380_dynamic_macro_record_validate(&record));
    zassert_equal(K380_MACRO_VM_OP_PRESS, record.package[16]);
    zassert_equal(0x60U, record.package[20]);
    zassert_equal(0xeaU, record.package[21]);
    zassert_equal(K380_MACRO_VM_OP_RELEASE, record.package[24]);
}

ZTEST(dynamic_macro_store, test_empty_legacy_macro_converts_to_empty_record)
{
    struct k380_dynamic_macro legacy = {
        .trigger = K380_DYNAMIC_MACRO_TRIGGER_ONCE,
        .count = 1U,
    };
    struct k380_dynamic_macro_record record;

    zassert_ok(k380_dynamic_macro_record_from_legacy(&legacy, &record));
    zassert_equal(0U, record.package_len);
    zassert_equal(0U, record.package_crc32);
    zassert_ok(k380_dynamic_macro_record_validate(&record));
}

ZTEST(dynamic_macro_store, test_save_load_and_slots_are_independent)
{
    struct k380_dynamic_macro_record source;
    struct k380_dynamic_macro_record loaded;

    k380_dynamic_macro_test_settings_reset();
    make_record(&source);
    zassert_ok(k380_dynamic_macro_store_save(0U, 0U, &source));
    source.name[0] = 'b';
    zassert_ok(k380_dynamic_macro_store_save(0U, 1U, &source));

    memset(&loaded, 0, sizeof(loaded));
    zassert_ok(k380_dynamic_macro_store_load(0U, 0U, &loaded));
    zassert_equal('t', loaded.name[0]);
    zassert_ok(k380_dynamic_macro_store_load(0U, 1U, &loaded));
    zassert_equal('b', loaded.name[0]);
}

ZTEST(dynamic_macro_store, test_loading_one_slot_ignores_other_slot_corruption)
{
    struct k380_dynamic_macro_record source;
    struct k380_dynamic_macro_record loaded;
    uint8_t corrupt[48] = {0};

    k380_dynamic_macro_test_settings_reset();
    make_record(&source);
    zassert_ok(k380_dynamic_macro_store_save(0U, 0U, &source));
    corrupt[0] = 0xffU;
    k380_dynamic_macro_test_settings_put(
        "k380/dynamic_config/v2/p/0/m/1", corrupt, sizeof(corrupt));

    memset(&loaded, 0, sizeof(loaded));
    zassert_ok(k380_dynamic_macro_store_load(0U, 0U, &loaded));
    zassert_equal('t', loaded.name[0]);
}

ZTEST(dynamic_macro_store, test_missing_slot_is_canonical_empty)
{
    struct k380_dynamic_macro_record loaded;

    k380_dynamic_macro_test_settings_reset();
    memset(&loaded, 0xff, sizeof(loaded));
    zassert_ok(k380_dynamic_macro_store_load(0U, 0U, &loaded));
    zassert_mem_equal(&loaded, &(struct k380_dynamic_macro_record){0},
                      sizeof(loaded));
}

ZTEST(dynamic_macro_store, test_legacy_migration_saves_v2_before_deleting_v1)
{
    struct k380_dynamic_macro legacy;
    struct k380_dynamic_macro_record loaded;

    k380_dynamic_macro_test_settings_reset();
    make_legacy(&legacy);
    k380_dynamic_macro_test_settings_put(
        "k380/dynamic_config/p/0/m/0", &legacy, sizeof(legacy));

    zassert_ok(k380_dynamic_macro_store_load(0U, 0U, &loaded));
    zassert_false(k380_dynamic_macro_test_settings_has(
        "k380/dynamic_config/p/0/m/0"));
    zassert_true(k380_dynamic_macro_test_settings_has(
        "k380/dynamic_config/v2/p/0/m/0"));
    zassert_equal(2U, k380_dynamic_macro_test_settings_operation_count());
    zassert_equal(0, strcmp("save:k380/dynamic_config/v2/p/0/m/0",
                             k380_dynamic_macro_test_settings_operation(0U)));
    zassert_equal(0, strcmp("delete:k380/dynamic_config/p/0/m/0",
                             k380_dynamic_macro_test_settings_operation(1U)));
}

ZTEST(dynamic_macro_store, test_failed_migration_write_preserves_v1)
{
    struct k380_dynamic_macro legacy;
    struct k380_dynamic_macro_record loaded;

    k380_dynamic_macro_test_settings_reset();
    make_legacy(&legacy);
    k380_dynamic_macro_test_settings_put(
        "k380/dynamic_config/p/0/m/0", &legacy, sizeof(legacy));
    k380_dynamic_macro_test_settings_fail_next_save();

    zassert_not_equal(0, k380_dynamic_macro_store_load(0U, 0U, &loaded));
    zassert_true(k380_dynamic_macro_test_settings_has(
        "k380/dynamic_config/p/0/m/0"));
    zassert_false(k380_dynamic_macro_test_settings_has(
        "k380/dynamic_config/v2/p/0/m/0"));
    zassert_equal(1U, k380_dynamic_macro_test_settings_operation_count());
}

ZTEST(dynamic_macro_store, test_restore_slot_deletes_both_versions)
{
    struct k380_dynamic_macro_record record;
    struct k380_dynamic_macro legacy;

    k380_dynamic_macro_test_settings_reset();
    make_record(&record);
    make_legacy(&legacy);
    k380_dynamic_macro_test_settings_put(
        "k380/dynamic_config/v2/p/0/m/0", &record,
        k380_dynamic_macro_record_wire_size(&record));
    k380_dynamic_macro_test_settings_put(
        "k380/dynamic_config/p/0/m/0", &legacy, sizeof(legacy));

    zassert_ok(k380_dynamic_macro_store_restore_slot(0U, 0U));
    zassert_false(k380_dynamic_macro_test_settings_has(
        "k380/dynamic_config/v2/p/0/m/0"));
    zassert_false(k380_dynamic_macro_test_settings_has(
                  "k380/dynamic_config/p/0/m/0"));
}

ZTEST(dynamic_macro_store,
      test_restore_slot_attempts_legacy_delete_after_v2_delete_failure)
{
    struct k380_dynamic_macro_record record;
    struct k380_dynamic_macro legacy;

    k380_dynamic_macro_test_settings_reset();
    make_record(&record);
    make_legacy(&legacy);
    k380_dynamic_macro_test_settings_put(
        "k380/dynamic_config/v2/p/0/m/0", &record,
        k380_dynamic_macro_record_wire_size(&record));
    k380_dynamic_macro_test_settings_put(
        "k380/dynamic_config/p/0/m/0", &legacy, sizeof(legacy));
    k380_dynamic_macro_test_settings_fail_next_delete();

    zassert_equal(-EIO, k380_dynamic_macro_store_restore_slot(0U, 0U));
    zassert_true(k380_dynamic_macro_test_settings_has(
        "k380/dynamic_config/v2/p/0/m/0"));
    zassert_false(k380_dynamic_macro_test_settings_has(
        "k380/dynamic_config/p/0/m/0"));
    zassert_equal(2U, k380_dynamic_macro_test_settings_operation_count());
}

ZTEST(dynamic_macro_store, test_invalid_indexes_are_rejected)
{
    struct k380_dynamic_macro_record record;

    k380_dynamic_macro_test_settings_reset();
    make_record(&record);
    zassert_equal(-EINVAL, k380_dynamic_macro_store_save(
                                K380_DYNAMIC_PRESET_COUNT, 0U, &record));
    zassert_equal(-EINVAL, k380_dynamic_macro_store_load(
                                0U, K380_DYNAMIC_MACRO_SLOT_COUNT, &record));
    zassert_equal(-EINVAL, k380_dynamic_macro_store_restore_preset(
                                K380_DYNAMIC_PRESET_COUNT));
}

ZTEST(dynamic_macro_store, test_all_maximum_records_fit_raw_budget)
{
    zassert_equal(73728U, K380_DYNAMIC_PRESET_COUNT *
                              K380_DYNAMIC_MACRO_SLOT_COUNT *
                              K380_DYNAMIC_MACRO_RECORD_MAX_BYTES);
}

ZTEST_SUITE(dynamic_macro_store, NULL, NULL, NULL, NULL, NULL);
```

## src/fake_settings.c
```c
#include <errno.h>
#include <stdbool.h>
#include <stddef.h>
#include <stdio.h>
#include <string.h>

#include <zephyr/settings/settings.h>

#include <zmk_keyboard_k380/dynamic_macro_record.h>
#include <zmk_keyboard_k380/dynamic_settings.h>

#define FAKE_SETTINGS_MAX_ENTRIES 128U
#define FAKE_SETTINGS_MAX_KEY_BYTES 96U
#define FAKE_SETTINGS_MAX_DATA_BYTES \
    K380_DYNAMIC_MACRO_RECORD_MAX_BYTES
#define FAKE_SETTINGS_MAX_OPERATIONS 256U

struct fake_settings_entry {
    bool used;
    char key[FAKE_SETTINGS_MAX_KEY_BYTES];
    uint8_t data[FAKE_SETTINGS_MAX_DATA_BYTES];
    size_t len;
};

static struct fake_settings_entry entries[FAKE_SETTINGS_MAX_ENTRIES];
static char operations[FAKE_SETTINGS_MAX_OPERATIONS][FAKE_SETTINGS_MAX_KEY_BYTES + 5U];
static size_t operation_count;
static bool fail_next_save;
static bool fail_next_delete;
static k_tid_t last_load_thread;

void k380_dynamic_settings_lock(void)
{
}

void k380_dynamic_settings_unlock(void)
{
}

static struct fake_settings_entry *find_entry(const char *key)
{
    for (size_t index = 0U; index < FAKE_SETTINGS_MAX_ENTRIES; index++) {
        if (entries[index].used && strcmp(entries[index].key, key) == 0) {
            return &entries[index];
        }
    }
    return NULL;
}

static struct fake_settings_entry *allocate_entry(void)
{
    for (size_t index = 0U; index < FAKE_SETTINGS_MAX_ENTRIES; index++) {
        if (!entries[index].used) {
            entries[index].used = true;
            return &entries[index];
        }
    }
    return NULL;
}

static void record_operation(const char *prefix, const char *key)
{
    if (operation_count >= FAKE_SETTINGS_MAX_OPERATIONS) {
        return;
    }
    (void)snprintf(operations[operation_count],
                   sizeof(operations[operation_count]), "%s%s", prefix, key);
    operation_count++;
}

void k380_dynamic_macro_test_settings_reset(void)
{
    memset(entries, 0, sizeof(entries));
    memset(operations, 0, sizeof(operations));
    operation_count = 0U;
    fail_next_save = false;
    fail_next_delete = false;
    last_load_thread = NULL;
}

void k380_dynamic_macro_test_settings_put(const char *key, const void *data,
                                           size_t len)
{
    struct fake_settings_entry *entry = find_entry(key);
    if (entry == NULL) {
        entry = allocate_entry();
    }
    if (entry == NULL || strlen(key) >= sizeof(entry->key) ||
        len > sizeof(entry->data)) {
        return;
    }
    strcpy(entry->key, key);
    memcpy(entry->data, data, len);
    entry->len = len;
}

bool k380_dynamic_macro_test_settings_has(const char *key)
{
    return find_entry(key) != NULL;
}

void k380_dynamic_macro_test_settings_fail_next_save(void)
{
    fail_next_save = true;
}

void k380_dynamic_macro_test_settings_fail_next_delete(void)
{
    fail_next_delete = true;
}

k_tid_t k380_dynamic_macro_test_settings_last_load_thread(void)
{
    return last_load_thread;
}

size_t k380_dynamic_macro_test_settings_operation_count(void)
{
    return operation_count;
}

const char *k380_dynamic_macro_test_settings_operation(size_t index)
{
    return index < operation_count ? operations[index] : NULL;
}

static int fake_read_cb(void *cb_arg, void *data, size_t len)
{
    const struct fake_settings_entry *entry = cb_arg;
    if (entry == NULL || len > entry->len) {
        return -EMSGSIZE;
    }
    memcpy(data, entry->data, len);
    return (int)len;
}

static bool key_in_subtree(const char *key, const char *subtree,
                           const char **relative)
{
    size_t subtree_len = strlen(subtree);
    if (strncmp(key, subtree, subtree_len) != 0 ||
        key[subtree_len] != '/') {
        return false;
    }
    *relative = &key[subtree_len + 1U];
    return **relative != '\0';
}

int k380_dynamic_macro_test_settings_save_one(const char *key,
                                              const void *value, size_t len)
{
    record_operation("save:", key);
    if (fail_next_save) {
        fail_next_save = false;
        return -EIO;
    }
    k380_dynamic_macro_test_settings_put(key, value, len);
    return 0;
}

int k380_dynamic_macro_test_settings_delete(const char *key)
{
    record_operation("delete:", key);
    if (fail_next_delete) {
        fail_next_delete = false;
        return -EIO;
    }
    struct fake_settings_entry *entry = find_entry(key);
    if (entry != NULL) {
        memset(entry, 0, sizeof(*entry));
    }
    return 0;
}

int k380_dynamic_macro_test_settings_load_subtree_direct(
    const char *subtree, settings_load_direct_cb callback, void *cb_arg)
{
    if (subtree == NULL || callback == NULL) {
        return -EINVAL;
    }
    last_load_thread = k_current_get();
    for (size_t index = 0U; index < FAKE_SETTINGS_MAX_ENTRIES; index++) {
        if (!entries[index].used) {
            continue;
        }
        const char *relative = NULL;
        if (!key_in_subtree(entries[index].key, subtree, &relative)) {
            continue;
        }
        int err = callback(relative, entries[index].len, fake_read_cb,
                           &entries[index], cb_arg);
        if (err != 0) {
            return err;
        }
    }
    return 0;
}
```

## src/fake_settings.h
```c
#ifndef K380_DYNAMIC_MACRO_STORE_FAKE_SETTINGS_H_
#define K380_DYNAMIC_MACRO_STORE_FAKE_SETTINGS_H_

#include <stdbool.h>
#include <stddef.h>

#include <zephyr/kernel.h>

void k380_dynamic_macro_test_settings_reset(void);
void k380_dynamic_macro_test_settings_put(const char *key, const void *data,
                                           size_t len);
bool k380_dynamic_macro_test_settings_has(const char *key);
void k380_dynamic_macro_test_settings_fail_next_save(void);
void k380_dynamic_macro_test_settings_fail_next_delete(void);
k_tid_t k380_dynamic_macro_test_settings_last_load_thread(void);
size_t k380_dynamic_macro_test_settings_operation_count(void);
const char *k380_dynamic_macro_test_settings_operation(size_t index);

#endif
```
