## app/boards/kimwolf/k380/Kconfig.k380
```kconfig
# Copyright (c) 2026
# SPDX-License-Identifier: Apache-2.0

config BOARD_K380
    select SOC_NRF52840_QIAA
    select ZMK_BOARD_COMPAT if BOARD_K380_NRF52840_ZMK
    imply RETAINED_MEM if BOARD_K380_NRF52840_ZMK
    imply RETENTION if BOARD_K380_NRF52840_ZMK
    imply RETENTION_BOOT_MODE if BOARD_K380_NRF52840_ZMK
```

## app/boards/kimwolf/k380/board.yml
```yaml
board:
  name: k380
  vendor: kimwolf
  socs:
    - name: nrf52840
      variants:
        - name: zmk
```

## zmk-keyboard-k380/Kconfig
```kconfig
menu "K380 keyboard module"

rsource "drivers/kscan/Kconfig"

config K380_STATUS_INDICATOR
    bool "K380 WS2812B status indicator"
    default n
    select LED_STRIP
    help
      Enables the K380 status indicator policy for the four board WS2812B
      pixels.

config K380_BLE_SLOT_POLICY
    bool "K380 BLE slot policy"
    default n
    depends on ZMK_BLE
    select K380_STATUS_INDICATOR
    help
      Enables the K380 three-slot BLE policy and status indicator mapping.

config K380_BATTERY_POLICY
    bool "K380 VDDH battery policy"
    default n
    depends on ZMK_BATTERY_REPORTING
    select K380_STATUS_INDICATOR
    select K380_SOFT_OFF
    help
      Enables K380 VDDH moving-average battery policy and status mapping.

config K380_SOFT_OFF
    bool "K380 low-voltage soft-off handling"
    default n
    depends on ZMK_PM_SOFT_OFF
    select SETTINGS
    select K380_STATUS_INDICATOR
    help
      Saves a one-time low-voltage shutdown reason and enters ZMK soft-off.

config K380_CONFIG_TOOL
    bool "K380 web configuration tool"
    default n
    select K380_DYNAMIC_CONFIG
    select K380_DYNAMIC_KEYMAP
    select K380_DYNAMIC_MACRO
    select K380_DYNAMIC_PRESET_SWITCH
    select K380_DYNAMIC_PROTOCOL
    select K380_DYNAMIC_TRANSPORT
    help
      Enables the K380 private USB CDC configuration protocol for runtime
      key remapping, presets, and macros without enabling ZMK Studio.

config K380_DYNAMIC_CONFIG
    bool "K380 runtime dynamic config"
    default n
    select SETTINGS

config K380_DYNAMIC_KEYMAP
    bool "K380 runtime dynamic keymap"
    default n
    depends on K380_DYNAMIC_CONFIG

config K380_DYNAMIC_MACRO
    bool "K380 runtime dynamic macro executor"
    default n
    depends on K380_DYNAMIC_CONFIG

config K380_DYNAMIC_PRESET_SWITCH
    bool "K380 runtime dynamic preset switch behavior"
    default n
    depends on K380_DYNAMIC_CONFIG

config K380_DYNAMIC_PROTOCOL
    bool "K380 private dynamic configuration protocol"
    default n
    depends on K380_DYNAMIC_CONFIG && K380_DYNAMIC_MACRO && K380_DYNAMIC_PRESET_SWITCH

config K380_DYNAMIC_TRANSPORT
    bool "K380 private dynamic configuration CDC transport"
    default n
    depends on K380_DYNAMIC_PROTOCOL
    select SERIAL
    select UART_INTERRUPT_DRIVEN
    help
      Uses the application-mode CDC UART chosen for the K380 configuration
      tool. This transport is independent from ZMK Studio.

config K380_BATTERY_POLICY_RUNTIME
    bool
    default y if K380_BATTERY_POLICY
    depends on K380_BATTERY_POLICY
    help
      Enables immediate K380 VDDH sampling on boot, wake, and USB state changes.

endmenu
```

## zmk-keyboard-k380/Kconfig.power-policy
```kconfig
config K380_AUTO_SYSTEM_OFF
    bool "K380 automatic BLE timeout system-off (hardware qualified)"
    default n
    help
      Permit BLE wait and pairing timeouts to start coordinated shutdown.
      Keep disabled until system-off wake is qualified on hardware. Low-voltage
      protection is independent of this gate.

config K380_BLE_WAIT_TIMEOUT_MS
    int "K380 bonded BLE wait timeout (ms)"
    default 30000
    range 1 2147483647

config K380_BLE_PAIRING_TIMEOUT_MS
    int "K380 BLE pairing timeout (ms)"
    default 60000
    range 1 2147483647

config K380_STARTUP_QUALIFICATION_BUDGET_MS
    int "K380 startup voltage qualification budget (ms)"
    default 1000
    range 1 1000

config K380_IDLE_SLEEP_TIMEOUT_MS
    int "K380 battery idle sleep timeout (ms)"
    default 600000
    range 1 2147483647

config K380_SOFT_OFF_WARNING_MS
    int "K380 soft-off warning duration (ms)"
    default 3000
    range 0 60000
    help
      Duration the shared soft-off warning indication is shown before the
      shutdown cleanup starts. Input stays suppressed for the whole window so
      USB insertion or a safe voltage recovery can still cancel the request.
      Zero disables the warning window.
```

## zmk-keyboard-k380/drivers/kscan/Kconfig
```kconfig
DT_COMPAT_K380_KSCAN_NO_DIODE_MATRIX := k380,kscan-no-diode-matrix

if KSCAN

config K380_KSCAN_NO_DIODE_MATRIX
    bool
    default $(dt_compat_enabled,$(DT_COMPAT_K380_KSCAN_NO_DIODE_MATRIX))
    select ZMK_KSCAN_GPIO_DRIVER

if K380_KSCAN_NO_DIODE_MATRIX

config ZMK_KSCAN_MATRIX_WAIT_BEFORE_INPUTS
    int "Microseconds to wait before reading K380 matrix inputs"
    default 0
    help
      Delay after selecting a matrix row before reading the column inputs.
      K380 uses the common ZMK matrix wait symbol without enabling the
      standard GPIO matrix driver.

config ZMK_KSCAN_MATRIX_WAIT_BETWEEN_OUTPUTS
    int "Microseconds to wait between K380 matrix outputs"
    default 0
    help
      Delay after releasing one K380 matrix row before selecting the next row.
      This lets the previous output settle on boards where row transitions can
      otherwise leak into the next scan window.

endif # K380_KSCAN_NO_DIODE_MATRIX

config K380_MATRIX_DIAGNOSTICS_RTT
    bool "Emit K380 matrix events over RTT"
    depends on K380_KSCAN_NO_DIODE_MATRIX
    default n
    help
      Emit each K380 kscan press and release as a plain text RTT line with
      both matrix coordinates and the recorded physical key name:
      K380_MATRIX row=<row> col=<column> key=<key> state=<down|up>.

      This is a hardware bring-up diagnostic path. It must stay disabled in
      normal K380 firmware builds.

config K380_MATRIX_DIAGNOSTICS_RTT_HEARTBEAT
    bool "Emit K380 RTT diagnostic heartbeat"
    depends on K380_MATRIX_DIAGNOSTICS_RTT
    default n
    help
      Emit one RTT heartbeat line per second. This is useful for proving that
      the application thread scheduler is alive, but should stay disabled
      during per-key matrix validation to keep the log readable.

endif # KSCAN
```

## zmk-keyboard-k380/dts/bindings/behaviors/k380,behavior-ble-slot.yaml
```yaml
# Copyright (c) 2026
# SPDX-License-Identifier: MIT

description: K380 BLE slot behavior

compatible: "k380,behavior-ble-slot"

include: two_param.yaml
```

## zmk-keyboard-k380/dts/bindings/behaviors/k380,behavior-dynamic-key.yaml
```yaml
description: K380 dynamic key behavior
compatible: "k380,behavior-dynamic-key"
include: two_param.yaml
properties:
  "#binding-cells":
    const: 2
```

## zmk-keyboard-k380/dts/bindings/behaviors/k380,behavior-preset-switch.yaml
```yaml
description: K380 dynamic preset switch behavior
compatible: "k380,behavior-preset-switch"
include: one_param.yaml
properties:
  "#binding-cells":
    const: 1
binding-cells:
  - preset
```

## zmk-keyboard-k380/dts/bindings/kscan/k380,kscan-no-diode-matrix.yaml
```yaml
description: K380 fixed 8x15 row2col no-diode GPIO keyboard matrix controller

compatible: "k380,kscan-no-diode-matrix"

include: kscan.yaml

properties:
  row-gpios:
    type: phandle-array
    required: true
    description: Eight active-high open-source row GPIOs.
  col-gpios:
    type: phandle-array
    required: true
    description: Fifteen active-high pull-down column GPIOs.
  debounce-press-ms:
    type: int
    default: 5
  debounce-release-ms:
    type: int
    default: 5
  debounce-scan-period-ms:
    type: int
    default: 1
  poll-period-ms:
    type: int
    default: 10
```

## zmk-keyboard-k380/tests/battery-policy/testcase.yaml
```yaml
tests:
  k380.battery_policy.runtime:
    platform_allow:
      - native_sim
    extra_configs:
      - CONFIG_SENSOR=y
    tags:
      - k380
      - integration
  k380.battery_policy:
    platform_allow:
      - native_sim
    tags:
      - k380
      - unit
```

## zmk-keyboard-k380/tests/ble-slot-policy/testcase.yaml
```yaml
tests:
  k380.ble_slot_policy:
    platform_allow:
      - native_sim
    tags:
      - k380
      - unit
```

## zmk-keyboard-k380/tests/dynamic-config/testcase.yaml
```yaml
tests:
  k380.dynamic_config:
    platform_allow:
      - native_sim
    tags:
      - k380
      - unit
```

## zmk-keyboard-k380/tests/dynamic-macro-vm-validate/testcase.yaml
```yaml
tests:
  k380.dynamic_macro_vm_validate:
    platform_allow:
      - native_sim
    tags:
      - k380
      - unit
```

## zmk-keyboard-k380/tests/dynamic-macro-vm/testcase.yaml
```yaml
tests:
  k380.dynamic_macro_vm:
    platform_allow:
      - native_sim
    tags:
      - k380
      - unit
```

## zmk-keyboard-k380/tests/dynamic-macro/testcase.yaml
```yaml
tests:
  k380.dynamic_macro:
    platform_allow:
      - native_sim
    tags:
      - k380
      - unit
```

## zmk-keyboard-k380/tests/dynamic-protocol/testcase.yaml
```yaml
tests:
  k380.dynamic_protocol:
    platform_allow:
      - native_sim
    tags:
      - k380
      - unit
```

## zmk-keyboard-k380/tests/ghost-filter/testcase.yaml
```yaml
tests:
  k380.ghost_filter:
    platform_allow:
      - native_sim
    tags:
      - k380
      - unit
```

## zmk-keyboard-k380/tests/low-power/testcase.yaml
```yaml
tests:
  k380.low_power:
    platform_allow:
      - native_sim
    tags:
      - k380
      - unit
  k380.low_power.formal_gate:
    platform_allow:
      - native_sim
    extra_configs:
      - CONFIG_K380_AUTO_SYSTEM_OFF=n
    tags:
      - k380
      - unit
```

## zmk-keyboard-k380/tests/shutdown-behavior/testcase.yaml
```yaml
tests:
  k380.shutdown_behavior:
    platform_allow:
      - native_sim
    tags:
      - k380
      - low_power
      - behavior
    integration_platforms:
      - native_sim
```

## zmk-keyboard-k380/tests/shutdown-input/testcase.yaml
```yaml
tests:
  k380.shutdown_input:
    platform_allow:
      - native_sim
    tags:
      - k380
      - hid
      - pm
```

## zmk-keyboard-k380/tests/soft-off/testcase.yaml
```yaml
tests:
  k380.soft_off:
    platform_allow:
      - native_sim
    tags:
      - k380
      - unit
```

## zmk-keyboard-k380/tests/status-indicator/testcase.yaml
```yaml
tests:
  k380.status_indicator:
    platform_allow:
      - native_sim
    tags:
      - k380
      - unit
```

## zmk-keyboard-k380/tests/system-off-wake/testcase.yaml
```yaml
tests:
  k380.system_off_wake:
    platform_allow:
      - native_sim
    tags:
      - k380
      - kscan
      - pm
```
